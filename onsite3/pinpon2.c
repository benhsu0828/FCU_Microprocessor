//
// TMR_LED : change LED on/off by Timer1 interrupt
//
#include <stdio.h>
#include <stdlib.h>
#include "string.h"
#include "NUC100Series.h"
#include "MCU_init.h"
#include "SYS_init.h"
#include "Seven_Segment.h"
#include "LCD.h"
#include "Note_Freq.h"

#define RXBUFSIZE 3
#define TXBUFSIZE 12
#define FG_COLOR 0xFFFF
#define BG_COLOR 0x0000

volatile uint8_t KEY_Flag;
volatile uint32_t index_key_scan;
volatile uint32_t index0_5ms, cnt0_5ms, cnt0_1s, cnt0_100ms;
volatile uint32_t index1_5ms, cnt1_5ms, cnt1_1s, cnt1_100ms;
volatile uint32_t count_Line = 0; 
volatile uint32_t count_Char;
volatile uint8_t u8ADF;
volatile uint32_t u32ADCvalue;
volatile uint32_t duty;
volatile int ball_x = 64;
volatile int ball_y = 32;
volatile int ball_vx = 1;
volatile int ball_vy = 1;
volatile int ball_dirx = 1;
volatile int ball_diry = 1;
volatile int pad_x = 0;
volatile int pad_y = 56;
volatile int ypad_x = 112;
volatile int ypad_y = 0;
volatile char RX_buffer[RXBUFSIZE];//you pad_x
volatile char TX_buffer[TXBUFSIZE];//my pad_x[3],ball_x[3],ball_y[2],digit[4]
volatile int UARTRead[RXBUFSIZE];
volatile int digit[4] = {0,0,0,0};
volatile int resultFlag = 0;
volatile int forCount = 0;
char line0[16] = "               ";
char line1[16] = "               ";
char line2[16] = "               ";
char line3[16] = "               ";
unsigned char pad[128*8] = {
	0x00,0x00,0x00,0x00,0x00,0x00,0x00,0x00,0x00,0x00,0x00,0x00,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0x00,
	0x00,0x00,0x00,0x00,0x00,0x00,0x00,0x00,0x00,0x00,0x00,0x00,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0x00,
	0x00,0x00,0x00,0x00,0x00,0x00,0x00,0x00,0x00,0x00,0x00,0x00,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0x00,
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	0x00,0x00,0x00,0x00,0x00,0x00,0x00,0x00,0x00,0x00,0x00,0x00,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0x00
};


void EINT1_IRQHandler(void)//PB15
{
    GPIO_CLR_INT_FLAG(PB, BIT15);  // Clear GPIO interrupt flag
}

void TMR0_IRQHandler(void){
    if (cnt0_5ms % 20 == 0) 
	{
        
		cnt0_100ms++;
    }
    if(cnt0_5ms % 200 == 0){
		cnt0_1s++;
	}
    cnt0_5ms++;
    TIMER_ClearIntFlag(TIMER0); // Clear Timer0 time-out interrupt flag
}

void TMR1_IRQHandler(void)
{// for keypad and seven segment
	if (cnt1_5ms % 20 == 0) 
	{
		cnt1_100ms++;
		index_key_scan = cnt1_100ms++ % 3;
		if (index_key_scan == 0)
		{
			PA0=1; PA1=1; PA2=1; PA3=1; PA4=1; PA5=0;
		}
		if (index_key_scan == 1)
		{
			PA0=1; PA1=1; PA2=1; PA3=1; PA4=0; PA5=1;
		}
		if (index_key_scan == 2)
		{
			PA0=1; PA1=1; PA2=1; PA3=0; PA4=1; PA5=1;
		}
		NVIC_EnableIRQ(GPAB_IRQn);
	}
	if(cnt1_5ms % 200 == 0){
		cnt1_1s++;
	}
    cnt1_5ms++;
    CloseSevenSegment();
    ShowSevenSegment(index1_5ms,digit[index1_5ms]);
    index1_5ms = cnt1_5ms % 4;
    TIMER_ClearIntFlag(TIMER1); // Clear Timer1 time-out interrupt flag
}

void GPAB_IRQHandler(void)
{
    NVIC_DisableIRQ(GPAB_IRQn);

    if (PA->ISRC & BIT0) {        // check if PA0 interrupt occurred
        PA0=1;
        PA->ISRC |= BIT0;         // clear PA0 interrupt status
    if (PA3==0) { KEY_Flag =3; PA3=1;cnt1_1s=0;}
    if (PA4==0) { KEY_Flag =6; PA4=1;cnt1_1s=0;}
    if (PA5==0) { KEY_Flag =9; PA5=1;cnt1_1s=0;}
    return;			
    } 
    if (PA->ISRC & BIT1) { // check if PA1 interrupt occurred
            PA1=1;
        PA->ISRC |= BIT1;         // clear PA1 interrupt status  
    if (PA3==0) { KEY_Flag =2; PA3=1;cnt1_1s=0;}
    if (PA4==0) { KEY_Flag =5; PA4=1;cnt1_1s=0;}
    if (PA5==0) { KEY_Flag =8; PA5=1;cnt1_1s=0;} 
    return;				
    } 
    if (PA->ISRC & BIT2) { // check if PB14 interrupt occurred
            PA2=1;
        PA->ISRC |= BIT2;         // clear PA interrupt status  feeddog();Leave_PowerDown();
    if (PA3==0) { KEY_Flag =1; PA3=1;cnt1_1s=0;}
    if (PA4==0) { KEY_Flag =4; PA4=1;cnt1_1s=0;}
    if (PA5==0) { KEY_Flag =7; PA5=1;cnt1_1s=0;}
    return;				
    }                     // else it is unexpected interrupts
    PA->ISRC = PA->ISRC;	      // clear all GPB pins
}

void UART02_IRQHandler(void)
{
	uint32_t u32IntSts= UART0->ISR; // UART interrupt status bit
	uint8_t c;
		
    if(u32IntSts & UART_IS_RX_READY(UART1)){
		UART_Read(UART0,RX_buffer,RXBUFSIZE);
        for(forCount = 0;forCount<RXBUFSIZE;forCount++){
            UARTRead[forCount] =RX_buffer[forCount] - 48;
        }
        ypad_x = UARTRead[0]*100+UARTRead[1]*10+UARTRead[2];
    }
}

void ADC_IRQHandler(void)
{
    uint32_t u32Flag;

    // Get ADC conversion finish interrupt flag
    u32Flag = ADC_GET_INT_FLAG(ADC, ADC_ADF_INT);

    if(u32Flag & ADC_ADF_INT)u8ADF = 1;
    u32ADCvalue = ADC_GET_CONVERSION_DATA(ADC, 7);
    pad_x = u32ADCvalue*100/4096;//turn 0~4096 to 0~100
    //printf("ADC7 = %d, duty =%d\n", u32ADCvalue, duty);    
    ADC_DisableInt(ADC, ADC_ADF_INT);
    ADC_CLR_INT_FLAG(ADC, u32Flag);
}

void getVR(){
    ADC_START_CONV(ADC);
    //remove sleep just start ADC interrupt
    // while (u8ADF == 0);
}

void Init_ALL(void)
{
    SYS_Init(); 
    init_LCD();
    clear_LCD();
    OpenSevenSegment();
	OpenKeyPad();
    u8ADF = 0;
    //Buzzer
    GPIO_SetMode(PB, BIT11, GPIO_MODE_OUTPUT); 
    //LED
	GPIO_SetMode(PC, (BIT12|BIT13|BIT14|BIT15), GPIO_MODE_OUTPUT);
    PC12=PC13=PC14=PC15=1;// turn off LED
    // // WDT timeout every 2^14 WDT clock, disable system reset, disable wake up system
    // SYS_UnlockReg();
    // WDT_Open(WDT_TIMEOUT_2POW16, 0, FALSE, FALSE);
    // WDT_EnableInt();          // Enable WDT timeout interrupt
    // NVIC_EnableIRQ(WDT_IRQn); // Enable Cortex-M0 NVIC WDT interrupt vector
    // SYS_LockReg();
    //GPIO RGBLED
    GPIO_SetMode(PA, BIT12, GPIO_MODE_OUTPUT);
    GPIO_SetMode(PA, BIT13, GPIO_MODE_OUTPUT);
    GPIO_SetMode(PA, BIT14, GPIO_MODE_OUTPUT);
    PA12=1;// PA12 = Blue,  0 : on, 1 : off
    PA13=1;// PA13 = Green, 0 : on, 1 : off
    PA14=1;// PA14 = Red,   0 : on, 1 : off
    //EXT
    // Configure EINT1 pin and enable interrupt by rising and falling edge trigger
    GPIO_SetMode(PB, BIT15, GPIO_MODE_INPUT);
    GPIO_EnableEINT1(PB, 15, GPIO_INT_RISING); // RISING, FALLING, BOTH_EDGE, HIGH, LOW
    NVIC_EnableIRQ(EINT1_IRQn);
    // Enable interrupt de-bounce function and select de-bounce sampling cycle time
    GPIO_SET_DEBOUNCE_TIME(GPIO_DBCLKSRC_LIRC, GPIO_DBCLKSEL_256);
    GPIO_ENABLE_DEBOUNCE(PB, BIT15);
    //TIMER0
    TIMER_Open(TIMER0, TMR0_OPERATING_MODE,200); // PERIODIC 200HZ = 5ms
    TIMER_EnableInt(TIMER0);
    NVIC_EnableIRQ(TMR0_IRQn);
    TIMER_Start(TIMER0);
    //TIMER1
    TIMER_Open(TIMER1, TMR1_OPERATING_MODE,200); // PERIODIC 200HZ = 5ms
    TIMER_EnableInt(TIMER1);
    NVIC_EnableIRQ(TMR1_IRQn);
    TIMER_Start(TIMER1);
    //keypad interrupt
    GPIO_SetMode(PA, (BIT0 | BIT1 | BIT2 |BIT3 | BIT4 | BIT5), GPIO_MODE_QUASI);
    GPIO_EnableInt(PA, 0, GPIO_INT_LOW);
    GPIO_EnableInt(PA, 1, GPIO_INT_LOW);
    GPIO_EnableInt(PA, 2, GPIO_INT_LOW);		
    NVIC_EnableIRQ(GPAB_IRQn);   
    NVIC_SetPriority(GPAB_IRQn,3);
    GPIO_SET_DEBOUNCE_TIME(GPIO_DBCLKSRC_LIRC, GPIO_DBCLKSEL_256);
    GPIO_ENABLE_DEBOUNCE(PA, (BIT0 | BIT1 | BIT2));	
    //ADC
	ADC_Open(ADC, ADC_INPUT_MODE, ADC_OPERATION_MODE, ADC_CHANNEL_MASK);
    ADC_POWER_ON(ADC);
    ADC_EnableInt(ADC, ADC_ADF_INT);
    NVIC_EnableIRQ(ADC_IRQn);
    // PWMA_Ch0 = 50Hz, 50% duty cycle
    PWM_ConfigOutputChannel(PWM1, PWM_CH0, 50, 50);
    PWM_EnableOutput(PWM1, PWM_CH_0_MASK);
    PWM_Start(PWM1, PWM_CH_0_MASK);
    //UART
    UART_Open(UART0, 115200);                     // set UART0 baud rate
    UART_ENABLE_INT(UART0, UART_IER_RDA_IEN_Msk); // enable UART0 interrupt (triggerred by Read-Data-Available)
    NVIC_EnableIRQ(UART02_IRQn);		              // enable Cortex-M0 NVIC interrupt for UART02
}

void judgeup(){
    if(ball_x > 112-pad_x && ball_x < 112-pad_x + 16){
        digit[2]++;
        if(digit[2] == 10){
            digit[2] = 0;
            digit[3]++;
        }
        PWM_ConfigOutputChannel(PWM1, PWM_CH0, 100, 90);
		PWM_EnableOutput(PWM1, PWM_CH_0_MASK);
    }
    if(digit[3]==1&&digit[2]==1){
        resultFlag = 1;
    }
}
void judgedown(){
    if(ball_x > pad_x && ball_x < pad_x + 16){
        digit[0]++;
        if(digit[0] == 10){
            digit[0] = 0;
            digit[1]++;
        }
        PWM_ConfigOutputChannel(PWM1, PWM_CH0, 100, 90);
		PWM_EnableOutput(PWM1, PWM_CH_0_MASK);
    }
    if(digit[1]==1&&digit[0]==1){
        resultFlag = 2;
    }
}
void setUARTWrite(){
    TX_buffer[0] = pad_x/100 + 48;
    TX_buffer[1] = pad_x/10-pad_x/100*10 + 48;
    TX_buffer[2] = pad_x%10 + 48;
    TX_buffer[3] = ball_x/100 + 48;
    TX_buffer[4] = ball_x/10-ball_x/100*10 + 48;
    TX_buffer[5] = ball_x%10 + 48;
    TX_buffer[6] = ball_y/10 + 48;
    TX_buffer[7] = ball_y%10 + 48;
    TX_buffer[8] = digit[0] + 48;
    TX_buffer[9] = digit[1] + 48;
    TX_buffer[10] = digit[2] + 48;
    TX_buffer[11] = digit[3] + 48;
}

int main(void)
{
  uint8_t ASSCII;
  uint16_t music[72] = {
		E6 ,D6u,E6 ,D6u,E6 ,B5 ,D6 ,C6 ,A5 ,A5 , 0 , 0 ,
		C5 ,E5 ,A5 ,B5 ,B5 , 0 ,C5 ,A5 ,B5 ,C6 ,C6 , 0 ,
		E6 ,D6u,E6 ,D6u,E6 ,B5 ,D6 ,C6 ,A5 ,A5 , 0 , 0 ,
		C5 ,E5 ,A5 ,B5 ,B5 , 0 ,E5 ,C6 ,B5 ,A5 ,A5 , 0 ,
		B5 ,C6 ,D6 ,E6 ,E6 , 0 ,G5 ,F6 ,E6 ,D6 ,D6 , 0 ,
		F5 ,E6 ,D6 ,C6 ,C6 , 0 ,E5 ,D6 ,C6 ,B5 ,B5 , 0 };
	int i = 0;
	
	Init_ALL();
	// //LCD back light
	// PD14 = 0;

	 while(1) {
        if(resultFlag == 0){
            getVR();
            if (cnt0_5ms % 20 == 0) 
            {
                PWM_DisableOutput(PWM1, PWM_CH_0_MASK);
                //pinpon move
                ball_x += ball_vx * ball_dirx;
                ball_y += ball_vy * ball_diry;
                if (ball_x > 128) {
                    ball_x = 128;
                    ball_dirx = -1;
                    PWM_ConfigOutputChannel(PWM1, PWM_CH0, 50, 90);
				    PWM_EnableOutput(PWM1, PWM_CH_0_MASK);
                }
                if (ball_x < 0) {
                    ball_x = 0;
                    ball_dirx = 1;
                    PWM_ConfigOutputChannel(PWM1, PWM_CH0, 50, 90);
				    PWM_EnableOutput(PWM1, PWM_CH_0_MASK);
                }
                if (ball_y > 64) {
                    judgedown();
                    ball_y = 64;
                    ball_diry = -1;
                    PWM_ConfigOutputChannel(PWM1, PWM_CH0, 50, 90);
				    PWM_EnableOutput(PWM1, PWM_CH_0_MASK);
                }
                if (ball_y < 0) {
                    judgeup();
                    ball_y = 0;
                    ball_diry = 1;
                    PWM_ConfigOutputChannel(PWM1, PWM_CH0, 50, 90);
				    PWM_EnableOutput(PWM1, PWM_CH_0_MASK);
                }
                cnt0_100ms++;
                //draw LCD
                clear_LCD();
                //draw ball
                draw_Circle(ball_x, ball_y, 8, 0XFF, 0x00);
                //draw pad
                draw_Bmp16x8(pad_x,pad_y ,FG_COLOR,BG_COLOR , pad);
                draw_Bmp16x8(ypad_x,ypad_y ,FG_COLOR,BG_COLOR , pad);
                //UART write
                setUARTWrite();
                UART_Write(UART0, TX_buffer, TXBUFSIZE);
            }
            
            switch(KEY_Flag){
                case 1:// 1
                    KEY_Flag = 0;
                    break;
                case 2:// 2 speed up
                    ball_vx++;
                    ball_vy++;
                    KEY_Flag = 0;
                    break;
                case 3:
                    KEY_Flag = 0;
                    break;
                case 4:// 
                    KEY_Flag = 0;
                    break;
                case 5:// 
                    KEY_Flag = 0;
                    break;
                case 6:// 
                    KEY_Flag = 0;
                    break;
                case 7:// =
                    clear_LCD();
                    KEY_Flag = 0;
                    break;
                case 8:// speed down
                    ball_vx--;
                    ball_vy--;
                    KEY_Flag = 0;
                    break;
                case 9:// 
                    KEY_Flag = 0;
                    break;
                default:
                    break;
            }
        }else if(resultFlag == 1){
            clear_LCD();
            sprintf(line1,"You lose");
            print_Line(1,line1);
            for (i=0; i<72; i++) {
                if(u32ADCvalue < 4000) break;
                PWM_ConfigOutputChannel(PWM1, PWM_CH0, music[i], 90); // 0=Buzzer ON
                if (music[i]!=0) PWM_EnableOutput(PWM1, PWM_CH_0_MASK);
                else             PWM_DisableOutput(PWM1, PWM_CH_0_MASK);
                CLK_SysTickDelay(250000/2);
            }
        }else if(resultFlag == 2){
            clear_LCD();
            sprintf(line1,"You win");
            print_Line(1,line1);
            for (i=0; i<72; i++) {
                if(u32ADCvalue < 4000) break;
                PWM_ConfigOutputChannel(PWM1, PWM_CH0, music[i], 90); // 0=Buzzer ON
                if (music[i]!=0) PWM_EnableOutput(PWM1, PWM_CH_0_MASK);
                else             PWM_DisableOutput(PWM1, PWM_CH_0_MASK);
                CLK_SysTickDelay(250000/2);
            }
        }
        
  }
}
